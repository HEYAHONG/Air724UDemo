## Kconfig
```kconfig
config CSDK_VER
    string "version"
    default "1.0.0"

config CSDK_PRO
    string "project name"
    default "Air724UDemo"

config FOTA_FLAG
    string "fota flag"
    default ""

config FOTA_TYPE
    string "fota_type"
    default ""

choice RELEASE_TYPE
    bool "release type"
    default RELEASE_TYPE_DEBUG

config  RELEASE_TYPE_DEBUG
    bool "debug"

config  RELEASE_TYPE_RELEASE
    bool "release"    

endchoice

choice CORE_TYPE
    bool "Core"
    default  CORE_BT_TTS_VOLTE

config CORE_BASE_NOT_CONFIG
    bool "Not Config"

config CORE_BASE
    bool "Base(APP RESOURCE:2300KB+ FileSystem 3700KB+ RAM)"

config CORE_BT_TTS
    bool "BT+TTS(APP RESOURCE:1400KB+ FileSystem 3400KB+ RAM)"

config CORE_BT_TTS_VOLTE
    bool "BT+TTS+VOLTE(APP RESOURCE:900KB+ FileSystem 800KB+ RAM)"

endchoice

config APP_ENTER_MESSAGE
    string "app enter message"
    default "APP Start"
config APP_EXIT_MESSAGE
    string "app exit message"
    default "APP Exit"

config APP_DEBUG
    bool "debug mode"
    default n



menuconfig APP_AUTOMOUNT_FLASH
    bool "internal flash filesystem automount"
    default y

if APP_AUTOMOUNT_FLASH

config APP_AUTOMOUNT_FLASH_PATH
    string "automount path"
    default "/filesystem"

endif


menu "CSDK"

source "csdk.Kconfig"

endmenu

menu "CPP"

source "cpp.Kconfig"

endmenu

menu "NetWork"

source "network.Kconfig"

endmenu

menu "Bluetooth"

source "bluetooth.Kconfig"

endmenu

menu "AppStack"

source "appstack/appstack.Kconfig"

endmenu
```
